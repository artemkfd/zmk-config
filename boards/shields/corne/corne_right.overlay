#include "corne.dtsi"

&default_transform {
    col-offset = <6>;
};

&kscan0 {
    col-gpios = <&pro_micro 3 GPIO_ACTIVE_HIGH>,
                <&pro_micro 7 GPIO_ACTIVE_HIGH>,
                <&pro_micro 6 GPIO_ACTIVE_HIGH>,
                <&pro_micro 5 GPIO_ACTIVE_HIGH>,
                <&pro_micro 4 GPIO_ACTIVE_HIGH>,
                <&pro_micro 2 GPIO_ACTIVE_HIGH>;
};
#include "corne.dtsi"

&default_transform {
    col-offset = <6>;
};

&kscan0 {
    col-gpios = <&pro_micro 2 GPIO_ACTIVE_HIGH>,  // D4 → P0.20 (Col 0)
                <&pro_micro 7 GPIO_ACTIVE_HIGH>,  // C6 → P0.13 (Col 1)
                <&pro_micro 6 GPIO_ACTIVE_HIGH>,  // D7 → P0.24 (Col 2)
                <&pro_micro 5 GPIO_ACTIVE_HIGH>,  // E6 → P0.09 (Col 3)
                <&pro_micro 4 GPIO_ACTIVE_HIGH>,  // B4 → P0.10 (Col 4)
                <&pro_micro 3 GPIO_ACTIVE_HIGH>;  // B5 → P1.06 (Col 5)

    row-gpios = <&pro_micro 21 (GPIO_ACTIVE_HIGH | GPIO_PULL_DOWN)>,  // D1 → P0.15 (Row 0)
                <&pro_micro 20 (GPIO_ACTIVE_HIGH | GPIO_PULL_DOWN)>,  // D0 → P0.17 (Row 1)
                <&pro_micro 19 (GPIO_ACTIVE_HIGH | GPIO_PULL_DOWN)>,  // F6 → P0.02 (Row 2)
                <&pro_micro 18 (GPIO_ACTIVE_HIGH | GPIO_PULL_DOWN)>;  // F5 → P0.31 (Row 3)
};
